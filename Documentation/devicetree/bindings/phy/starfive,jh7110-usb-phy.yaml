## Documentation/devicetree/bindings/phy/starfive,jh7110-usb-phy.yaml
```yaml
# SPDX-License-Identifier: (GPL-2.0-only OR BSD-2-Clause)
%YAML 1.2
---
$id: http://devicetree.org/schemas/phy/starfive,jh7110-usb-phy.yaml#
$schema: http://devicetree.org/meta-schemas/core.yaml#

title: StarFive USB 2.0 and 3.0 PHY

maintainers:
  - Minda Chen<minda.chen@starfivetech.com>

properties:
  compatible:
    items:
      - const: starfive,jh7110-usb-phy

  reg:
    maxItems: 2

  reg-names:
    items:
      - const: usb3
      - const: usb2

  clocks:
    maxItems: 8

  clock-names:
    items:
       - const: usb_125m
       - const: usb0_app_125
       - const: usb0_lpm
       - const: usb0_stb
       - const: usb0_apb
       - const: usb0_axi
       - const: usb0_utmi_apb

  resets:
    items:
       - description: USB0_PWRUP reset
       - description: USB0_APB reset
       - description: USB0_AXI reset
       - description: USB0_UTMI_APB reset

  starfive,sys-syscon:
    $ref: /schemas/types.yaml#/definitions/phandle-array
    items:
      items:
        - description: phandle to System Register Controller sys_syscon node.
        - description: offset of SYS_SYSCONSAIF__SYSCFG register for USB.
    description:
      The phandle to System Register Controller syscon node and the offset
      of SYS_SYSCONSAIF__SYSCFG register for USB.

  starfive,stg-syscon:
    $ref: /schemas/types.yaml#/definitions/phandle-array
      items:
        - description: phandle to System Register Controller stg_syscon node.
        - description: offset of STG_SYSCONSAIF__SYSCFG register for USB.
    description:
      The phandle to System Register Controller syscon node and the offset
      of STG_SYSCONSAIF__SYSCFG register for USB. Total 4 regsisters offset
      for USB.

  dr_mode:
    description: PHY mode.
    enum:
      - host
      - peripheral
      - otg

  starfive,usb2-only
    description: Set USB using usb 2.0 phy. Supprt USB 2.0 only

  '#phy-cells':
    const: 0

required:
  - compatible
  - reg
  - reg-names
  - clocks
  - clock-names
  - reset
  - starfive,sys-syscon
  - starfive,stg-syscon
  - dr_mode
  - '#phy-cells'

additionalProperties: false

examples:
  - |
    usbphy@10200000 {
      compatible = "starfive,jh7110-usb";
      reg = <0x0 0x10210000 0x0 0x1000>,
            <0x0 0x10200000 0x0 0x1000>;
      reg-names = "usb3", "usb2";
      clocks = <&syscrg 95>,
               <&stgcrg 6>,
               <&stgcrg 4>,
               <&stgcrg 5>,
               <&stgcrg 1>,
               <&stgcrg 3>,
               <&stgcrg 2>;
      clock-names = "usb_125m", "usb0_app_125", "usb0_lpm",
                    "usb0_stb", "usb0_apb", "usb0_axi", "usb0_utmi_apb";
      resets = <&stgcrg 10>,
               <&stgcrg 8>,
               <&stgcrg 7>,
               <&stgcrg 9>;
      starfive,stg-syscon = <&stg_syscon 0x4 0xc4 0x148 0x1f4>;
      starfive,sys-syscon = <&sys_syscon 0x18>;
      dr_mode = "host";
      #phy-cells = <0>;
    };
```

## Documentation/devicetree/bindings/timer/starfive,jh7110-timers.yaml
```yaml
# SPDX-License-Identifier: (GPL-2.0-only OR BSD-2-Clause)
%YAML 1.2
---
$id: http://devicetree.org/schemas/timer/starfive,jh7110-timers.yaml#
$schema: http://devicetree.org/meta-schemas/core.yaml#

title: StarFive Timers

maintainers:
  - Samin Guo <samin.guo@starfivetech.com>
  - Xingyu Wu <xingyu.wu@starfivetech.com>

properties:
  compatible:
    const: starfive,jh7110-timers

  reg:
    maxItems: 1

  interrupts:
    items:
      - description: timer channel 0 interrupt
      - description: timer channel 1 interrupt
      - description: timer channel 2 interrupt
      - description: timer channel 3 interrupt

  interrupt-names:
    items:
      - const: timer0
      - const: timer1
      - const: timer2
      - const: timer3

  clocks:
    items:
      - description: timer channel 0 clock
      - description: timer channel 1 clock
      - description: timer channel 2 clock
      - description: timer channel 3 clock
      - description: APB clock

  clock-names:
    items:
      - const: timer0
      - const: timer1
      - const: timer2
      - const: timer3
      - const: apb

  resets:
    items:
      - description: timer channel 0 reset
      - description: timer channel 1 reset
      - description: timer channel 2 reset
      - description: timer channel 3 reset
      - description: APB reset

  reset-names:
    items:
      - const: timer0
      - const: timer1
      - const: timer2
      - const: timer3
      - const: apb

  clock-frequency:
    description: The frequency of the clock that drives the counter, in Hz.

required:
  - compatible
  - reg
  - interrupts
  - interrupt-names
  - clocks
  - clock-names
  - resets
  - reset-names
  - clock-frequency

unevaluatedProperties: false

examples:
  - |
    timer@13050000 {
        compatible = "starfive,jh7110-timers";
        reg = <0x13050000 0x10000>;
        interrupts = <69>, <70>, <71> ,<72>;
        interrupt-names = "timer0", "timer1", "timer2", "timer3";
        clocks = <&clk 125>,
                 <&clk 126>,
                 <&clk 127>,
                 <&clk 128>,
                 <&clk 124>;
        clock-names = "timer0", "timer1",
                      "timer2", "timer3", "apb";
        resets = <&rst 118>,
                 <&rst 119>,
                 <&rst 120>,
                 <&rst 121>,
                 <&rst 117>;
        reset-names = "timer0", "timer1",
                      "timer2", "timer3", "apb";
        clock-frequency = <24000000>;
    };
```

## Documentation/devicetree/bindings/watchdog/starfive,jh7110-wdt.yaml
```yaml
# SPDX-License-Identifier: (GPL-2.0-only OR BSD-2-Clause)
%YAML 1.2
---
$id: http://devicetree.org/schemas/watchdog/starfive,jh7110-wdt.yaml#
$schema: http://devicetree.org/meta-schemas/core.yaml#

title: StarFive Watchdog

maintainers:
  - Samin Guo <samin.guo@starfivetech.com>
  - Xingyu Wu <xingyu.wu@starfivetech.com>

description:
  The watchdog is a 32 bit counter and has two timeout phases.
  At the first phase, the signal of watchdog interrupt output(WDOGINT)
  will rise when counter is 0. The counter will reload the timeout value.
  And then, if counter decreases to 0 again and WDOGINT isn't cleared,
  the watchdog will reset the system unless the watchdog reset is disabled.

allOf:
  - $ref: watchdog.yaml#

properties:
  compatible:
    const: starfive,jh7110-wdt

  reg:
    maxItems: 1

  interrupts:
    maxItems: 1

  clocks:
    items:
      - description: APB clock
      - description: Core clock

  clock-names:
    items:
      - const: apb
      - const: core

  resets:
    items:
      - description: APB reset
      - description: Core reset

  reset-names:
    items:
      - const: apb
      - const: core

required:
  - compatible
  - reg
  - clocks
  - clock-names
  - resets
  - reset-names

unevaluatedProperties: false

examples:
  - |
    watchdog@13070000 {
        compatible = "starfive,jh7110-wdt";
        reg = <0x13070000 0x10000>;
        clocks = <&clk 122>,
                 <&clk 123>;
        clock-names = "apb", "core";
        resets = <&rst 109>,
                 <&rst 110>;
        reset-names = "apb", "core";
    };
```
